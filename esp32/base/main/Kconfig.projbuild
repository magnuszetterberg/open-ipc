## esp32/base/main/Kconfig.projbuild
```kconfig
menu "wfb-ng link"

    config LINK_CHANNEL
        int "WiFi channel"
        range 1 13
        default 6
        help
            Must match the cameras' channel.

    config LINK_ID
        hex "Link ID"
        range 0x0 0xffffff
        default 0x0

    config BASE_CAMERAS
        int "Cameras"
        range 1 3
        default 3
        help
            Camera N (0, 1, 2) sends video on radio port N and telemetry on port 0x10 + N (docs/DESIGN.md).

    config LINK_RING_SIZE
        int "FEC blocks kept per video stream while waiting for missing packets"
        range 1 40
        default 1
        help
            Each block costs about 12 x 1.5 KB of RAM per camera. One block is enough on a radio that
            delivers in order (test_rx checks it), and it is what lets three cameras fit without PSRAM.
            wfb_rx on Linux keeps 40.

    config LINK_RX_SLOTS
        int "Received frames that can wait to be processed"
        range 4 64
        default 10
        help
            Each costs about 1.5 KB of internal RAM. Three cameras and Ethernet leave little to spare on an
            ESP32 without PSRAM (#20). A camera sends each JPEG as a burst of about 12 packets, which
            8 slots didn't always hold.

endmenu

menu "Ethernet out"

    config BASE_ETHERNET
        bool "Ethernet (Olimex ESP32-POE)"
        default y
        help
            Off: receive and report only, e.g. on an ESP32-CAM standing in as a base station for tests.
            (The ESP32-POE's Ethernet pins include GPIO16/17, which the ESP32-CAM's PSRAM uses.)

    config BASE_RTSP_PORT
        int "RTSP port"
        range 1 65535
        default 8554
        help
            Each camera plays at rtsp://<base station>:<port>/camN.

    config BASE_RTSP_CLIENTS
        int "RTSP clients at once"
        range 1 6
        default 2
        help
            Each costs its buffer (below) and about 2 KB.

    config BASE_RTSP_CLIENT_BUFFER
        int "RTSP buffer per client (bytes)"
        range 2048 16384
        default 4096
        help
            Video waiting for a client's TCP connection, on top of lwIP's own send buffer. A client that falls
            further behind loses whole RTP packets.

    config BASE_WEB
        bool "Web view"
        default y
        help
            http://<base station>/: a tile per camera with its live video (MJPEG) and telemetry (M7).

    config BASE_WEB_PORT
        int "Web view port"
        depends on BASE_WEB
        range 1 65535
        default 80

    config BASE_WEB_CLIENTS
        int "Web connections at once"
        depends on BASE_WEB
        range 1 8
        default 4
        help
            Each camera playing in a browser takes one, and the page's status requests one briefly: a page
            with three cameras needs four. A connection over the limit gets "503 too many viewers".

    config BASE_WEB_CLIENT_BUFFER
        int "Web buffer per connection (bytes)"
        depends on BASE_WEB
        range 1280 16384
        default 2048
        help
            Video waiting for a viewer's TCP connection, on top of lwIP's own send buffer. A viewer that falls
            further behind loses the rest of a frame, and gets the next one it has room for.

    config BASE_RAM_RESERVE
        int "RAM kept free for receiving (bytes)"
        range 4096 32768
        default 10240
        help
            Data for RTSP clients and web viewers is held back while sending it would leave less free RAM
            than this. TCP's buffers come from the same RAM as the radio's and Ethernet's: run dry, and every
            camera's video breaks up, not just the slow viewer's.

    config BASE_OUT_HOST
        string "Send camera 0's video and every camera's telemetry to (IPv4 address)"
        default ""
        help
            Camera 0's RTP/JPEG goes there as UDP (e.g. a PC running VIDEO=jpeg pc/receiver.sh), and each
            camera's telemetry, with the base station's signal quality added, goes to the telemetry port
            + N (pc/burnin.sh reads it; ./ipc flash base sets this PC). Empty: RTSP only.

    config BASE_OUT_PORT
        int "Video UDP port"
        range 1 65535
        default 5600
        help
            receiver.sh listens on 5600.

    config BASE_TELEMETRY_PORT
        int "Telemetry UDP port, camera 0"
        range 1 65535
        default 5610
        help
            Camera N's telemetry goes to this port + N. burnin.sh reads 5610.

endmenu
```

## esp32/camera/main/Kconfig.projbuild
```kconfig
menu "wfb-ng link"

    config LINK_CHANNEL
        int "WiFi channel"
        range 1 13
        default 6
        help
            Must match CHANNEL on the receiver (link.sh's default is 6).

    config LINK_MCS
        int "HT20 MCS index"
        range 0 7
        default 3
        help
            The data rate. MCS 3 is 26 Mbit/s, as link.sh's MCS default.

    config LINK_TX_POWER_DBM
        int "Transmit power (dBm)"
        range 2 20
        default 20

    config LINK_ID
        hex "Link ID"
        range 0x0 0xffffff
        default 0x0
        help
            wfb-ng's link_id; with the radio port it makes the channel_id the receiver listens for.

    config LINK_RADIO_PORT
        int "Radio port"
        range 0 255
        default 0
        help
            One per camera on a shared receiver. link.sh's wfb_rx listens on port 0.

    config LINK_TELEMETRY
        bool "Send telemetry"
        default y
        help
            Once a second, a small JSON message on its own radio port: uptime, frame rate, frame
            size, transmit power, temperature (null: the ESP32 has no supported sensor).

    config LINK_TELEMETRY_PORT
        int "Telemetry radio port"
        depends on LINK_TELEMETRY
        range 0 255
        default 16
        help
            0x10 + the camera's index (16, 17, 18), next to video on ports 0, 1, 2 (docs/DESIGN.md).

    config LINK_TELEMETRY_INTERVAL_MS
        int "Telemetry interval (ms)"
        depends on LINK_TELEMETRY
        range 100 10000
        default 1000

    config LINK_FEC_K
        int "FEC k (data packets per block)"
        range 1 32
        default 8

    config LINK_FEC_N
        int "FEC n (data + FEC packets per block)"
        range 1 32
        default 12

    choice LINK_PAYLOAD
        prompt "What to send"
        default LINK_PAYLOAD_VIDEO

        config LINK_PAYLOAD_VIDEO
            bool "Camera video (RTP/JPEG)"
            help
                Play it on the receiver with VIDEO=jpeg ./rx.sh.

        config LINK_PAYLOAD_COUNTER
            bool "Counter (link test)"
            help
                Numbered payloads instead of video, for checking the link itself:
                esp32/tools/counter_check.py on the receiver reports any that go missing.
    endchoice

    config LINK_COUNTER_RATE
        int "Counter payloads per second"
        depends on LINK_PAYLOAD_COUNTER
        range 1 1000
        default 100

    config LINK_COUNTER_SIZE
        int "Counter payload size in bytes"
        depends on LINK_PAYLOAD_COUNTER
        range 32 1448
        default 1000

endmenu

menu "Camera"
    depends on LINK_PAYLOAD_VIDEO

    choice CAMERA_FRAME_SIZE
        prompt "Frame size"
        default CAMERA_FRAME_VGA

        config CAMERA_FRAME_QVGA
            bool "320x240"
        config CAMERA_FRAME_VGA
            bool "640x480"
        config CAMERA_FRAME_SVGA
            bool "800x600"
    endchoice

    config CAMERA_CLOSE_BLOCK_PER_FRAME
        bool "Finish the FEC block at the end of each frame"
        default y
        help
            A 640x480 frame is about 7 packets, an FEC block 8. Finishing the block after each frame
            (padding it, as wfb_tx's FEC timeout does) lets the receiver recover a lost packet at once,
            instead of when the next frame completes the block 40 ms later. Costs about 14% airtime.

    config CAMERA_JPEG_QUALITY
        int "JPEG quality (lower is better and bigger)"
        range 4 63
        default 12
        help
            The OV2640's JPEG quality setting. 12 gives about 11 KB per 640x480 frame.

endmenu
```

## esp32/components/keys/Kconfig
```kconfig
menu "Link key"

    config WFB_KEY_FILE
        string "Key file, relative to the repo root"
        default "keys/drone.key"
        help
            A wfb_keygen key file of 64 bytes. The camera uses drone.key and the base station gs.key.
            The default is the repo's test key from the password "change-me": anyone with the repo
            can read and inject into the link. For anything beyond desk tests, run ./ipc keys: your
            own pair in keys/own/ (never committed) then replaces the test keys in every build.

endmenu
```

## esp32/radar/build-sweep/Kconfig/Kconfig.modules
```kconfig
menu "cmsis (/home/magnus/zephyr/zephyr-v4.4.2/modules/hal/cmsis)"
osource "$(ZEPHYR_CMSIS_KCONFIG)"
config ZEPHYR_CMSIS_MODULE
	bool
	default y
endmenu
menu "cmsis_6 (/home/magnus/zephyr/zephyr-v4.4.2/modules/hal/cmsis_6)"
osource "$(ZEPHYR_CMSIS_6_KCONFIG)"
config ZEPHYR_CMSIS_6_MODULE
	bool
	default y
endmenu
menu "hal_nxp (/home/magnus/zephyr/zephyr-v4.4.2/modules/hal/nxp)"
osource "$(ZEPHYR_HAL_NXP_KCONFIG)"
config ZEPHYR_HAL_NXP_MODULE
	bool
	default y
	select TAINT_BLOBS

config ZEPHYR_HAL_NXP_MODULE_BLOBS
	bool
	default y
endmenu
menu "hostap (/home/magnus/zephyr/zephyr-v4.4.2/modules/lib/hostap)"
osource "$(ZEPHYR_HOSTAP_KCONFIG)"
config ZEPHYR_HOSTAP_MODULE
	bool
	default y
endmenu
menu "mbedtls (/home/magnus/zephyr/zephyr-v4.4.2/modules/crypto/mbedtls)"
osource "$(ZEPHYR_MBEDTLS_KCONFIG)"
config ZEPHYR_MBEDTLS_MODULE
	bool
	default y
endmenu
menu "picolibc (/home/magnus/zephyr/zephyr-v4.4.2/modules/lib/picolibc)"
osource "/home/magnus/zephyr/zephyr-v4.4.2/modules/lib/picolibc/zephyr/Kconfig"
config ZEPHYR_PICOLIBC_MODULE
	bool
	default y
endmenu
config ZEPHYR_TF_PSA_CRYPTO_MODULE
	bool
	default y
```

## esp32/radar/build-sweep/Kconfig/Kconfig.sysbuild.modules
```kconfig
config ZEPHYR_CMSIS_MODULE
   bool
   default y
config ZEPHYR_CMSIS_6_MODULE
   bool
   default y
config ZEPHYR_HAL_NXP_MODULE
   bool
   default y
config ZEPHYR_HOSTAP_MODULE
   bool
   default y
config ZEPHYR_MBEDTLS_MODULE
   bool
   default y
config ZEPHYR_PICOLIBC_MODULE
   bool
   default y
config ZEPHYR_TF_PSA_CRYPTO_MODULE
   bool
   default y
```

## esp32/radar/build-sweep/Kconfig/arch/Kconfig
```kconfig
# Load Zephyr Arch Kconfig descriptions.
osource "/home/magnus/zephyr/zephyr-v4.4.2/zephyr/arch/rx/Kconfig"
osource "/home/magnus/zephyr/zephyr-v4.4.2/zephyr/arch/x86/Kconfig"
osource "/home/magnus/zephyr/zephyr-v4.4.2/zephyr/arch/xtensa/Kconfig"
osource "/home/magnus/zephyr/zephyr-v4.4.2/zephyr/arch/sparc/Kconfig"
osource "/home/magnus/zephyr/zephyr-v4.4.2/zephyr/arch/riscv/Kconfig"
osource "/home/magnus/zephyr/zephyr-v4.4.2/zephyr/arch/posix/Kconfig"
osource "/home/magnus/zephyr/zephyr-v4.4.2/zephyr/arch/openrisc/Kconfig"
osource "/home/magnus/zephyr/zephyr-v4.4.2/zephyr/arch/mips/Kconfig"
osource "/home/magnus/zephyr/zephyr-v4.4.2/zephyr/arch/arm64/Kconfig"
osource "/home/magnus/zephyr/zephyr-v4.4.2/zephyr/arch/arm/Kconfig"
osource "/home/magnus/zephyr/zephyr-v4.4.2/zephyr/arch/arc/Kconfig"
```

## esp32/radar/build-sweep/Kconfig/boards/Kconfig.defconfig.tmp
```kconfig
# Load Zephyr board defconfig descriptions.
osource "/home/magnus/zephyr/zephyr-v4.4.2/zephyr/boards/nxp/frdm_rw612/Kconfig.defconfig"
```

## esp32/radar/build-sweep/Kconfig/boards/Kconfig.tmp
```kconfig
# Load Zephyr board Kconfig descriptions.
osource "/home/magnus/zephyr/zephyr-v4.4.2/zephyr/boards/nxp/frdm_rw612/Kconfig"
```
